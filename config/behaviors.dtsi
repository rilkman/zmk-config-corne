/ {
    behaviors {
        mt {
            compatible = "zmk,behavior-hold-tap";
            label = "MT";
            flavor = "tap-preferred";              // Options: "hold-preferred", "balanced", "tap-preferred", "tap-unless-interrupted"
            tapping-term-ms = <250>;               // Duration in milliseconds to distinguish tap from hold
            require-prior-idle-ms = <250>;         // 
        };
    };
};
